## package/aic8800/Config.in
```kconfig
config BR2_PACKAGE_AIC8800
	bool "aic8800"
	depends on BR2_LINUX_KERNEL
	select BR2_PACKAGE_USB_MODESWITCH
	select BR2_PACKAGE_UTIL_LINUX
	select BR2_PACKAGE_UTIL_LINUX_EJECT
	help
	  Out-of-tree AICSemi AIC8800-family Wi-Fi 6 USB driver, Bluetooth
	  firmware loader, device-specific ZLP quirk module, udev rules, and
	  required firmware. Installs all six firmware variant directories
	  under /lib/firmware/aic8800*/.

	  The udev rules handle AIC USB storage-mode ejects and Pandora
	  1111:1111 mode switching. usb_modeswitch and its device-specific
	  configuration are included for the latter.

	  Uses shenmintao/aic8800d80's main branch. It supports devices with
	  chip_mcu_id=0 or an unknown MCU revision; do not use this package
	  for chip_mcu_id=1 hardware, which requires the upstream
	  legacy-mcu1 branch and matching firmware.

	  The driver has no upstream license grant beyond its module
	  declarations, and the firmware has no separate license text.
	  See package/aic8800/aic8800.mk and docs/wifi-parity.md section
	  10.1 for source and licensing details.

	  https://github.com/shenmintao/aic8800d80

comment "aic8800 needs a Linux kernel to be built"
	depends on !BR2_LINUX_KERNEL
```
